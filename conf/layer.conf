## conf/layer.conf
```bitbake
# We have a conf and classes directory, add to BBPATH
BBPATH .= ":${LAYERDIR}"

# We have recipes-* directories, add to BBFILES
BBFILES += "${LAYERDIR}/recipes-*/*/*.bb \
            ${LAYERDIR}/recipes-*/*/*.bbappend"

BBFILE_COLLECTIONS += "meta-yann"
BBFILE_PATTERN_meta-yann = "^${LAYERDIR}/"
BBFILE_PRIORITY_meta-yann = "99"

LAYERDEPENDS_meta-yann = "core"
LAYERSERIES_COMPAT_meta-yann = "dunfell"
```
